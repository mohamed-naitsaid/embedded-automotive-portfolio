AUTOSAR XML (schema 00051)
package /Components/SwcImplementations
  swc implementation SWC_LedControl_Impl: programming-language=C, sw-version=1.3.1, used-code-generator=Embedded Coder 24.1 (R2024a) 19-Nov-2023, vendor-id=0, behavior=SWC_LedControl_IB
    code-descriptors:
      code Code
        artifact-descriptors:
          short-label=SWC_LedControl_c, category=SWSRC
          short-label=SWC_LedControl_h, category=SWHDR
          short-label=SWC_LedControl_private_h, category=SWHDR
          short-label=SWC_LedControl_types_h, category=SWHDR
    resource consumption RsrcCons_SWC_LedControl

AUTOSAR XML (schema 00051)
package /Interfaces
  sender receiver interface LedCommand
    data LedCommand: category=VALUE, sw-calibration-access=READ-ONLY, type=boolean
